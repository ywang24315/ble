## prj.conf
```kconfig
#
# Copyright (c) 2018 Nordic Semiconductor
#
# SPDX-License-Identifier: LicenseRef-Nordic-5-Clause
#

# Enable the UART driver
CONFIG_UART_ASYNC_API=y
CONFIG_NRFX_UARTE0=y
CONFIG_SERIAL=y
CONFIG_PINCTRL=y
CONFIG_GPIO=y

# Make sure printk is printing to the UART console
CONFIG_CONSOLE=y
CONFIG_UART_CONSOLE=y

CONFIG_HEAP_MEM_POOL_SIZE=2048

CONFIG_BT=y
CONFIG_BT_PERIPHERAL=y
CONFIG_BT_DEVICE_NAME="Nordic_UART_Service"
#CONFIG_BT_GATT_BLOOD_PRESSURE=y
CONFIG_BT_MAX_CONN=1
CONFIG_BT_MAX_PAIRED=1

# Enable the NUS service
CONFIG_BT_NUS=y

# Enable bonding
CONFIG_BT_SETTINGS=y
CONFIG_FLASH=y
CONFIG_FLASH_PAGE_LAYOUT=y
CONFIG_FLASH_MAP=y

# Enable DK LED and Buttons library
CONFIG_DK_LIBRARY=y

# This example requires more stack
CONFIG_MAIN_STACK_SIZE=1152
CONFIG_SYSTEM_WORKQUEUE_STACK_SIZE=2048

# Config logger
CONFIG_LOG=y
CONFIG_USE_SEGGER_RTT=y
CONFIG_LOG_BACKEND_RTT=y
CONFIG_LOG_BACKEND_UART=n
CONFIG_LOG_PRINTK=n

CONFIG_ASSERT=y
```

## src/my_service.c
```c
#include "my_service.h"
#include <zephyr/bluetooth/gatt.h>
#include <string.h>

static struct date_t current_date = {
    .year = 2025,
    .month = 5,
    .day = 6,
};

void my_service_set_date(uint16_t year, uint8_t month, uint8_t day)
{
    // current_date.year = year;
    // current_date.month = month;
    // current_date.day = day;
}
```

## src/my_service.h
```c
#include <stdint.h>

#ifndef MY_SERVICE_H
#define MY_SERVICE_H

void my_service_set_date(uint16_t year, uint8_t month, uint8_t day);

#endif
```
